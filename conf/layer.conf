## conf/layer.conf
```bitbake
# We have a conf and classes directory, add to BBPATH
BBPATH .= ":${LAYERDIR}"

# We have recipes-* directories, add to BBFILES
BBFILES += "${LAYERDIR}/recipes-*/*/*.bb \
            ${LAYERDIR}/recipes-*/*/*.bbappend"

BBFILE_COLLECTIONS += "meta-esec-awsclient"
BBFILE_PATTERN_meta-esec-awsclient = "^${LAYERDIR}/"
BBFILE_PRIORITY_meta-esec-awsclient = "6"

LAYERDEPENDS_meta-esec-awsclient = "core"
LAYERSERIES_COMPAT_meta-esec-awsclient = "zeus"
```
